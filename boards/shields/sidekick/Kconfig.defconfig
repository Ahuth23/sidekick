## config/west.yml
```yaml
manifest:
  remotes:
    - name: zmkfirmware
      url-base: https://github.com/zmkfirmware
    - name: sidekick
      urlbase: https://github.com/Ahuth23/sidekick
  projects:
    - name: zmk
      remote: zmkfirmware
      revision: main
      import: app/west.yml
    - name: sidekick
      remote: zmkfirmware
      revision: main
  self:
    path: config
```
